## config/west.yml
```yaml
manifest:
  remotes:
    - name: zmkfirmware
      url-base: https://github.com/zmkfirmware
    - name: tangbonze
      url-base: https://github.com/tangbonze
    - name: whoop-t #new entry
      url-base: https://github.com/whoop-t #new entry
  projects:
    - name: zmk
      remote: zmkfirmware
      revision: v0.2
      import: app/west.yml
    - name: nice-adventure-time #new entry
      remote: whoop-t #new entry
      revision: main #new entry
    - name: zmk-pmw3610-driver
      remote: tangbonze
      revision: main
  self:
    path: config
```
